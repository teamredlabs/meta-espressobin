## conf/layer.conf
```bitbake
# Layer configuration for meta-espressobin
# Copyright 2018 TeamRed Security Inc.

# We have a conf and classes directory, add to BBPATH
BBPATH .= ":${LAYERDIR}"

# We have recipes-* directories, add to BBFILES
BBFILES += "${LAYERDIR}/recipes-*/*/*.bb \
    ${LAYERDIR}/recipes-*/*/*.bbappend \
    ${LAYERDIR}/classes/*.bbclass \
"

BBFILE_COLLECTIONS += "espressobin"
BBFILE_PATTERN_espressobin = "^${LAYERDIR}/"
BBFILE_PRIORITY_espressobin = "6"
```

## conf/machine/espressobin-v5.conf
```bitbake
#@TYPE: Machine
#@NAME: Globalscale Marvell ESPRESSObin Board V5
#@SOC: ARMADA 3720
#@DESCRIPTION: Machine configuration for Globalscale Marvell ESPRESSObin Board V5

require conf/machine/include/espressobin-v5.inc
```

## conf/machine/espressobin-v7.conf
```bitbake
#@TYPE: Machine
#@NAME: Globalscale Marvell ESPRESSObin Board V7
#@SOC: ARMADA 3720
#@DESCRIPTION: Machine configuration for Globalscale Marvell ESPRESSObin Board V7

require conf/machine/include/espressobin-v7.inc
```

## conf/machine/include/arm/espressobin-arch-armv4.inc
```bitbake
DEFAULTTUNE ?= "armv4"

TUNEVALID[arm] = "Enable ARM instruction set"
TUNEVALID[armv4] = "Enable instructions for ARMv4"
TUNE_CCARGS .= "${@bb.utils.contains('TUNE_FEATURES', 'armv4', ' -march=armv4${ARMPKGSFX_THUMB}', '', d)}"

FIX_V4BX_ARMV4 = "${@bb.utils.contains('TUNE_FEATURES', 'armv4', '--fix-v4bx', '', d)}"
FIX_V4BX_ARMV5 = "${@bb.utils.contains('TUNE_FEATURES', 'armv5', '', '${FIX_V4BX_ARMV4}', d)}"
FIX_V4BX = "${@bb.utils.contains('TUNE_FEATURES', 'thumb', '', '${FIX_V4BX_ARMV5}', d)}"
TARGET_LD_KERNEL_ARCH += "${FIX_V4BX}"
MACHINEOVERRIDES =. "${@bb.utils.contains('TUNE_FEATURES', 'armv4', 'armv4:', '' ,d)}"

require conf/machine/include/arm/espressobin-arch-arm.inc
require conf/machine/include/arm/espressobin-feature-arm-thumb.inc

# Little Endian
AVAILTUNES += "armv4 armv4t"
ARMPKGARCH_tune-armv4  ?= "armv4"
ARMPKGARCH_tune-armv4t ?= "armv4"
TUNE_FEATURES_tune-armv4  = "arm armv4"
TUNE_FEATURES_tune-armv4t = "${TUNE_FEATURES_tune-armv4} thumb"
PACKAGE_EXTRA_ARCHS_tune-armv4  = "arm armv4"
PACKAGE_EXTRA_ARCHS_tune-armv4t = "${PACKAGE_EXTRA_ARCHS_tune-armv4} armv4t"

# Big Endian
AVAILTUNES += "armv4b armv4tb"
ARMPKGARCH_tune-armv4b  ?= "armv4"
ARMPKGARCH_tune-armv4tb ?= "armv4"
TUNE_FEATURES_tune-armv4b  = "${TUNE_FEATURES_tune-armv4}  bigendian"
TUNE_FEATURES_tune-armv4tb = "${TUNE_FEATURES_tune-armv4t} bigendian"
PACKAGE_EXTRA_ARCHS_tune-armv4b  = "armeb armv4b"
PACKAGE_EXTRA_ARCHS_tune-armv4tb = "${PACKAGE_EXTRA_ARCHS_tune-armv4b} armv4tb"
```

## conf/machine/include/arm/espressobin-feature-arm-neon.inc
```bitbake
TUNEVALID[neon] = "Enable Neon SIMD accelerator unit."
TUNE_CCARGS_MFPU .= "${@bb.utils.contains('TUNE_FEATURES', 'neon', ' neon', '', d)}"

TUNEVALID[vfpv3d16] = "Enable Vector Floating Point Version 3 with 16 registers (vfpv3-d16) unit."
TUNE_CCARGS_MFPU .= "${@bb.utils.contains('TUNE_FEATURES', 'vfpv3d16', ' vfpv3d16', '', d)}"

TUNEVALID[vfpv3] = "Enable Vector Floating Point Version 3 with 32 registers (vfpv3) unit."
TUNE_CCARGS_MFPU .= "${@bb.utils.contains('TUNE_FEATURES', 'vfpv3', ' vfpv3', '' , d)}"

TUNEVALID[vfpv4] = "Enable Vector Floating Point Version 4 (vfpv4) unit."
TUNE_CCARGS_MFPU .= "${@bb.utils.contains('TUNE_FEATURES', 'vfpv4', ' vfpv4', '', d)}"
TUNE_CCARGS_MFPU .= "${@bb.utils.contains('TUNE_FEATURES', [ 'vfpv4', 'neon' ], ' neon-vfpv4', '', d)}"
```

## conf/machine/include/arm/espressobin-feature-arm-vfp.inc
```bitbake
TUNEVALID[vfp] = "Enable Vector Floating Point (vfp) unit."
TUNE_CCARGS_MFPU .= "${@bb.utils.contains('TUNE_FEATURES', 'vfp', ' vfp', '', d)}"

TUNE_CCARGS  .= "${@ (' -mfpu=%s ' % d.getVar('TUNE_CCARGS_MFPU', True).split()[-1]) if (d.getVar('TUNE_CCARGS_MFPU', True) != '') else ''}"
ARMPKGSFX_FPU = "${@ ('-%s'        % d.getVar('TUNE_CCARGS_MFPU', True).split()[-1]) if (d.getVar('TUNE_CCARGS_MFPU', True) != '') else ''}"

TUNEVALID[callconvention-hard] = "Enable EABI hard float call convention, requires VFP."
TUNE_CCARGS_MFLOAT = "${@ bb.utils.contains('TUNE_FEATURES', 'callconvention-hard', 'hard', 'softfp', d) if (d.getVar('TUNE_CCARGS_MFPU', True) != '') else '' }"
TUNE_CCARGS   .= "${@ ' -mfloat-abi=${TUNE_CCARGS_MFLOAT}' if (d.getVar('TUNE_CCARGS_MFLOAT', True) != '')     else ''}"
ARMPKGSFX_EABI = "${@ 'hf'                                 if (d.getVar('TUNE_CCARGS_MFLOAT', True) == 'hard') else ''}"
```

## conf/machine/include/espressobin-base.inc
```bitbake
require conf/machine/include/arm/espressobin-arch-arm64.inc

MACHINEOVERRIDES =. "espressobin:"
MACHINE_ENDIANNESS ?= "le"
MACHINE_ESSENTIAL_EXTRA_RDEPENDS += "kernel-image kernel-devicetree"
MACHINE_EXTRA_RRECOMMENDS += "kernel-modules"
MACHINE_FEATURES = "ext2 ipsec nfs pci smbfs usbgadget usbhost vfat"
MACHINE_FEATURES_BACKFILL_CONSIDERED = "rtc qemu-usermode"

require conf/multilib.conf

MULTILIBS = "multilib:lib32"
DEFAULTTUNE_virtclass-multilib-lib32 = "armv8a-neon"
DEFAULTTUNE ?= "${@bb.utils.contains("MACHINE_ENDIANNESS", "le", "aarch64", "aarch64_be", d)}"

PREFERRED_PROVIDER_virtual/kernel ?= "linux-espressobin"
PREFERRED_PROVIDER_virtual/bootloader ?= "u-boot-espressobin"

PREFERRED_PROVIDER_linux ?= "linux-espressobin"
PREFERRED_PROVIDER_u-boot ?= "u-boot-espressobin"
PREFERRED_PROVIDER_u-boot-fw-utils ?= "u-boot-espressobin-fw-utils"
PREFERRED_PROVIDER_arm-trusted-firmware ?= "arm-trusted-firmware-espressobin"

IMAGE_FSTYPES += "tar.bz2"
IMAGE_BOOT_FILES = "Image;Image"

KERNEL_IMAGETYPE = "Image"

SERIAL_CONSOLE = "115200 ttyMV0"
```

## conf/machine/include/espressobin-v5.inc
```bitbake
require conf/machine/include/espressobin-base.inc

MACHINEOVERRIDES =. "espressobin-v5:"

ATF_PLATFORM = "a3700"
ATF_DDR_TOPOLOGY = "2"
ATF_CLOCKSPRESET = "CPU_1000_DDR_800"
ATF_BOOT_DEV = "SPINOR"
ATF_BOOT_PART = "0"

UBOOT_MACHINE = "mvebu_espressobin-88f3720_defconfig"
UBOOT_DEVICE_TREE = "armada-3720-espressobin"

KERNEL_DEVICETREE = "marvell/armada-3720-espressobin.dtb"
IMAGE_BOOT_FILES_append = " Image-armada-3720-espressobin.dtb;fdt.dtb"
```

## conf/machine/include/espressobin-v7.inc
```bitbake
require conf/machine/include/espressobin-base.inc

MACHINEOVERRIDES =. "espressobin-v7:"

ATF_PLATFORM = "a3700"
ATF_DDR_TOPOLOGY = "5"
ATF_CLOCKSPRESET = "CPU_1000_DDR_800"
ATF_BOOT_DEV = "SPINOR"
ATF_BOOT_PART = "0"

UBOOT_MACHINE = "mvebu_espressobin-88f3720_defconfig"
UBOOT_DEVICE_TREE = "armada-3720-espressobin-emmc"

KERNEL_DEVICETREE = "marvell/armada-3720-espressobin-v7-emmc.dtb"
IMAGE_BOOT_FILES_append = " armada-3720-espressobin-v7-emmc.dtb;fdt.dtb"
```
